## main/Kconfig.projbuild
```kconfig
menu "Sparta Ion Config"
    config ION_BUTTON
        bool "Enable button"
        default y

    config ION_BUTTON_BOARD_PIN
        int "Board button pin"
        default 0
    
    config ION_BUTTON_EXTERNAL_PIN
        int "External button pin"
        default 4
    
    config ION_LED_PIN
        int "Led pin"
        default 2

    config ION_LIGHT
        bool "Enable pin for controlling light"
        default n

    config ION_LIGHT_PIN
        int "Light pin"
        default 33

    config ION_LIGHT_PIN_INVERTED
        bool "Light pin low for on"
        default n

    config ION_RELAY
        bool "Enable pin for controlling motor power"
        default n

    config ION_RELAY_PIN
        int "Motor relay pin"
        default 32

    config ION_RELAY_PIN_INVERTED
        bool "Motor relay pin low for on"
        default n

    config ION_CHARGE
        bool "Enable pin to switch to charging mode"
        default n

    config ION_CHARGE_PIN
        int "Charge input pin"
        default 34

    config ION_CU2
        bool "Enable CU2 display support"
        default y

    config ION_CU3
        bool "Enable CU3 display support"
        default n

    config ION_UART
        int "UART number connected to bus"
        default 2

    config ION_RXD
        int "Receive pin connected to bus"
        default 16

    config ION_TXD
        int "Send pin connected to bus"
        default 17

    config ION_ADC
        bool "Enable ADC for battery voltage measurement"
        default n

    config ION_ADC_CHAN
        int "ADC channel to use for voltage measurement"
        default 7

    config ION_DIVIDER_SCALE
        int "The division of the voltage divider, times 1000. For example 150k & 10k resistor is: ((150 + 10) / 10) * 1000 = 16000."
        default 16000

    config ION_ADC_EMPTY_MV
        int "The actual battery voltage in mv for empty (=0%). For example 32000mv for a 10s battery"
        default 32000

    config ION_ADC_FULL_MV
        int "The actual battery voltage in mv for full (=100%). For example 42000mv for a 10s battery"
        default 42000

    config ION_CURR_ADC
        bool "Enable ADC for current measurement"
        default n

    config ION_CURR_ADC_CHAN
        int "ADC channel to use for current measurement"
        default 6

    config ION_BAT_CHARGE
        int "Full battery charge in mAh."
        default 10000

    config CONFIG_ION_KEEPALIVE
        bool "Enable keepalive heartbeat. Will reset the ESP32 when main loop is stuck for more than a minute."
        default n

endmenu
```

## sdkconfig.defaults
```kconfig
CONFIG_ION_CU2=n
CONFIG_ION_CU3=y

# My chips are 4MB flash, once you use OTA this settings matters
CONFIG_ESPTOOLPY_FLASHSIZE_4MB=y

# Set up partitions for SPIFFS
CONFIG_PARTITION_TABLE_CUSTOM=y
CONFIG_PARTITION_TABLE_CUSTOM_FILENAME="partitions.csv"

CONFIG_FREERTOS_HZ=1000

CONFIG_LOG_COLORS=
#CONFIG_LOG_DEFAULT_LEVEL_DEBUG=y
```

## sdkconfig.defaults.esp32
```kconfig
CONFIG_ION_BUTTON=y
CONFIG_ION_LED_PIN=2
CONFIG_ION_UART=2
CONFIG_ION_RXD=16
CONFIG_ION_TXD=17

CONFIG_ION_LIGHT=y
CONFIG_ION_LIGHT_PIN=33
CONFIG_ION_LIGHT_PIN_INVERTED=y

CONFIG_ION_RELAY=y
CONFIG_ION_RELAY_PIN=32
CONFIG_ION_RELAY_PIN_INVERTED=y

CONFIG_ION_ADC=y

# 2.65V is 40.1V in realty due to voltage divider
# Ratio is 40.1 / 2.65 = ~15.13 (measured scale, using this)

# Divider is 3K3 + 5K1 = 8K4 and 118K. Total 126K4.
# Ratio is 126K4 / 8K4 = ~15.05 (calculated scale, for reference)

# The scale of the divider, times 1000
CONFIG_ION_DIVIDER_SCALE=15130

# Consider 30V (3.0V/cell for 10s) empty
CONFIG_ION_ADC_EMPTY_MV=30000

# Consider 42V (4.2V/cell for 10s) full
CONFIG_ION_ADC_FULL_MV=42000

CONFIG_ESP32_DEFAULT_CPU_FREQ_240=y
```

## sdkconfig.defaults.esp32c3
```kconfig
# Configuration for use with T-01C3: https://github.com/Xinyuan-LilyGO/T-01C3
#
# Pins:
# Pin# from schematic(GPIO#) - Name on (ESP-01) breakout board - Name on T-01C3 board
# 1(--) - GND  - GND
# 2(02) - GP2  - IO2 > Optional ADC use for battery level
# 3(09) - GP0  - IO9 > Motor on/off (active low)
# 4(20) - RXD  - RX  > Bus send
# 5(21) - TXD  - TX  > Light on/off (active high) + jumper for debug
# 6(08) - CHPD - IO8 > Bus receive
# 7(--) - RST  - RST
# 8(--) - VCC  - 3.3V


CONFIG_ION_BUTTON=n
CONFIG_ION_LED_PIN=3
CONFIG_ION_UART=1
CONFIG_ION_RXD=8
CONFIG_ION_TXD=20

CONFIG_ION_LIGHT=y
CONFIG_ION_LIGHT_PIN=21
CONFIG_ION_LIGHT_PIN_INVERTED=n

CONFIG_ION_RELAY=y
CONFIG_ION_RELAY_PIN=9
CONFIG_ION_RELAY_PIN_INVERTED=y

CONFIG_ESP32C3_DEFAULT_CPU_FREQ_160=y

CONFIG_ION_ADC=y

# Voltage dividers with a factor of 16 tend to be easy to find resistors for:
# 150k & 10k
# 180k & 12k
# 240k & 16k
# 270k & 18k
# 300k & 20k
# 330k & 22k
# 360k & 24k

# The scale of the divider, times 1000
CONFIG_ION_DIVIDER_SCALE=16000

# Consider 32V (3.2V/cell for 10s) empty
CONFIG_ION_ADC_EMPTY_MV=32000

# Consider 42V (4.2V/cell for 10s) full
CONFIG_ION_ADC_FULL_MV=42000
```
